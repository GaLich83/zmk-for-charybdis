## config/west.yml
```yaml
manifest:
  remotes:
    - name: zmkfirmware
      url-base: https://github.com/zmkfirmware
    - name: GaLich83
      url-base: https://github.com/GaLich83
  projects:
    - name: zmk
      remote: zmkfirmware
      revision: v0.3
      import: app/west.yml
    # PMW3610-драйвер: форк GaLich83 (badjeff-based), ветка
    # zmk-0.3-motion-flush, запинен на SHA. Совместим с новым pointing-API
    # ZMK v0.3 (CONFIG_ZMK_POINTING). Содержит два фикса поверх zmk-0.3:
    #  1) motion-flush в конце configure (фантомный рывок на первое касание);
    #  2) half-duplex чтение регистров (3-проводной SPI, duplex=2048) —
    #     убран ведущий full-duplex пропуск байта, иначе чтения разъезжаются.
    - name: zmk-pmw3610-driver
      remote: GaLich83
      revision: 0dc6ebc3525f6e213dec8de8bf7d5fadafe711da

  self:
    path: config
```
